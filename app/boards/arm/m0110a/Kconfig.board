## app/boards/arm/m0110a/Kconfig.board
```kconfig
# m0110a board configuration

# Copyright (c) 2020 The ZMK Contributors
# SPDX-License-Identifier: MIT

config BOARD_M0110A
	bool "m0110a Keyboard"
	depends on SOC_NRF52840_QIAA
```
